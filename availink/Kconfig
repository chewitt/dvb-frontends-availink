## availink/Kconfig
```kconfig
# SPDX-License-Identifier: GPL-2.0-only
menu "Support for Amlogic DVB cards"
	depends on ARCH_MESON || COMPILE_TEST

config DVB_MESON
        tristate "Availink Demodulator Support"
        depends on DVB_CORE
        select DVB_AVL
        imply DVB_AVL62X1
        imply DVB_AVL68X2
	imply DVB_MXL608
        help
          Select Y or M to add support for Amlogic Meson DVB cards

config DVB_AVL
	tristate "Availink Common Functions"
	help
	  Select Y or M to add support for Availink BSP common functions

config DVB_AVL62X1
        tristate "Availink 62x1 Demodulator Support"
        help
          Select Y or M to add support for Availink AVL62x1 demodulator chips

config DVB_AVL68X2
        tristate "Availink 68x2 Demodulator Support"
        help
          Select Y or M to add support for Availink AVL68x2 demodulator chips

config DVB_MXL608
        tristate "MaxLinear MXL608 Tuner Support"
        help
          Select Y or M to add support for Availink AVL68x2 demodulator chips
```
